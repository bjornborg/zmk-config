## config/west.yml
```yaml
manifest:
  remotes:
    # - name: zmkfirmware
    #   url-base: https://github.com/zmkfirmware
    # - name: petejohanson
    #   url-base: https://github.com/petejohanson
  projects:
    - name: zmk
      # remote: katona
      # revision: split_battery_service
      # remote: petejohanson
      # revision: feat/pointers-move-scroll
      # import: app/west.yml
  self:
    path: config
```
